## lazy-br2/Config.in
```kconfig
source "$BR2_EXTERNAL_LAZY_OS_PATH/package/lazy-os/Config.in"
source "$BR2_EXTERNAL_LAZY_OS_PATH/package/llama-cpp/Config.in"
```

## lazy-br2/package/lazy-os/Config.in
```kconfig
config BR2_PACKAGE_LAZY_OS
	bool "lazy-os"
	select BR2_PACKAGE_PYTHON3
	select BR2_PACKAGE_PYTHON_PYYAML
	select BR2_PACKAGE_PYTHON_JSONSCHEMA
	help
	  Lazy OS core microservices, REST gateway, HUD Command Center,
	  and systemd sandbox units.
```

## lazy-br2/package/llama-cpp/Config.in
```kconfig
config BR2_PACKAGE_LLAMA_CPP
	bool "llama-cpp"
	depends on BR2_INSTALL_LIBSTDCPP
	help
	  llama.cpp lightweight tensor inference engine for in-guest LLMs.
```
